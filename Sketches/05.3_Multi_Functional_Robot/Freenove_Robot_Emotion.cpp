#include <cstddef>
#include <Arduino.h>
#include "Freenove_VK16K33_Lib.h"
#include "Freenove_Robot_For_Pico_W.h"
#include "Freenove_Robot_Emotion.h"

//Turn eyes clockwise
byte eyeRotate1[][8] = {
  0x00,0x3C,0x4E,0x4E,0x7E,0x7E,0x3C,0x00,
  0x00,0x3C,0x66,0x66,0x7E,0x7E,0x3C,0x00,
  0x00,0x3C,0x72,0x72,0x7E,0x7E,0x3C,0x00,
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  0x00,0x3C,0x7E,0x4E,0x4E,0x7E,0x3C,0x00,
};

//Turn eyes counterclockwise
byte eyeRotate2[][8] = {
  0x00,0x3C,0x72,0x72,0x7E,0x7E,0x3C,0x00,
  0x00,0x3C,0x66,
  0x66,
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  0x00,
};

//Blink eyes
byte eyeBlink[][8] = {
  0x00,
  0x00,
  0x3C,
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  0x00,
};

//keep smile
byte eyeSmile[][8] = {
  0x00,
  0x00,
  0x18,
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  0x00,
};

//cry-left
byte eyeCry1[][8] = {
  0x00,
  0x00,
  0x7E,
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  0x00,
};

//cry-right
byte eyeCry2[][8] = {
  0x00,
  0x00,
  0x7E,
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  0x00,
};

//wheel-left
byte wheel_left[][8] = {
  0x18,
  0x10,
  0x10,
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  0x30,
};

//wheel-right
byte wheel_right[][8] = {
  0x18,0x08,0x08,0xF9,0x9F,0x10,0x10,0x18,
  0x04,0x42,0xA4,0x18,0x18,0x25,0x42,0x20,
  0x30,0x10,0x11,0x1F,0xF8,0x88,0x08,0x0C,
};

//static emotion -left
byte static_emotion_left[][8] = {
  0x44, 0x28, 0x10, 0x28, 0x44, 0x00, 0x00, 0x07,
  0x00, 0x00, 0x00, 0x38, 0x00, 0x00, 0x00, 0x07,
  0x38, 0x44, 0x54, 0x54, 0x44, 0x38, 0x00, 0x03,
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  0x00, 0x03, 0x04, 0x05, 0x05, 0x04, 0x03, 0x00
};

//static emotion -right
byte static_emotion_right[][8] = {
  0x22, 0x14, 0x08, 0x14, 0x22, 0x00, 0x00, 0xE0,
  0x00, 0x1C, 0x1C, 0x1C, 0x00, 0x00, 0x20, 0xE0,
  0x1C, 0x22, 0x2A, 0x2A, 0x22, 0x1C, 0x00, 0xC0,
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  0x00, 0xC0, 0x20, 0xA0, 0xA0, 0x20, 0xC0, 0x00
  
};

//clear
byte clearEmotion[][8] = {
  0x00,0x00,0x00,0x00,0x00,0x00,0x00,0x00,
};

//Turn eyes clockwise
byte smile1[][8] = {
  0x00,0x00,0x40,0x20,0x10,0x08,0x07,0x00,
  0x00,0x40,0x20,0x10,0x08,0x07,0x00,0x00,
};

//Turn eyes counterclockwise
byte smile2[][8] = {
  0x00,0x00,0x02,0x04,0x08,0x10,0xE0,0x00,
  0x00,0x02,0x04,0x08,0x10,0xE0,0x00,0x00,
};

// naughty1
byte naughty1[][8] = {
  0x00,0x3F,0x40,0x40,0x20,0x10,0x08,0x07,
  0x00,0x3F,0x40,0x47,0x27,0x10,0x08,0x07,
  0x00,0x3F,0x40,0x40,0x20,0x10,0x08,0x07,
  0x00,0x3F,0x40,0x40,0x20,0x10,0x08,0x07,
  0x00,0x3F,0x40,0x40,0x20,0x17,0xF,0x07,

  // 0x00,0x00,0x1F,0x08,0x04,0x03,0x00,0x00,
  // 0x00,0x00,0x1F,0x09,0x04,0x03,0x00,0x00,
  // 0x00,0x00,0x1F,0x08,0x04,0x03,0x00,0x00,
  // 0x00,0x00,0x1F,0x08,0x04,0x03,0x00,0x00,
  // 0x00,0x00,0x1F,0x08,0x05,0x03,0x00,0x00,
};
//naughty2
byte naughty2[][8] = {
  0x00,0xFC,0x02,0x02,0x04,0x08,0x10,0xE0,
  0x00,0xFC,0x02,0x02,0x04,0x08,0x10,0xE0,
  0x00,0xFC,0x02,0xE2,0xE4,0x08,0x10,0xE0,
  0x00,0xFC,0x02,0x02,0x04,0xE8,0xF0,0xE0,
  0x00,0xFC,0x02,0x02,0x04,0x08,0x10,0xE0,

  // 0x00,0x00,0xF8,0x10,0x20,0xC0,0x00,0x00,
  // 0x00,0x00,0xF8,0x10,0x20,0xC0,0x00,0x00,
  // 0x00,0x00,0xF8,0x90,0x20,0xC0,0x00,0x00,
  // 0x00,0x00,0xF8,0x10,0xA0,0xC0,0x00,0x00,
  // 0x00,0x00,0xF8,0x10,0x20,0xC0,0x00,0x00,
};

//wrath1
byte wrath1[][8] = {
  // 0x00,0x00,0x07,0x08,0x10,0x10,0x00,0x00,0x00,0x00,0x07,0x08,0x13,0x14,0x00,0x00,
  0x00,0x00,0xF,0x10,0x10,0x10,0x00,0x00,
  0x00,0x00,0xF,0x10,0x17,0x17,0x00,0x00,
};
//wrath2
byte wrath2[][8] = {
  // 0x00,0x00,0xE0,0x10,0x08,0x08,0x00,0x00,0x00,0x00,0xE0,0x10,0xC8,0x28,0x00,0x00,
  0x00,0x00,0xF0,0x08,0x08,0x08,0x00,0x00,
  0x00,0x00,0xF0,0x08,0xE8,0xE8,0x00,0x00,
};


//sad
byte sad1[][8] = {
  0x00,0x07,0x08,0x10,0x20,0x40,0x00,0x00,
  0x00,0x00,0x07,0x08,0x10,0x20,0x40,0x00,
  // 0x00,0x03,0x04,0x08,0x10,0x20,0x00,0x00,0x00,0x00,0x03,0x04,0x08,0x10,0x20,0x00,//sad1
};
//sad
byte sad2[][8] = {
  0x00,0xE0,0x10,0x08,0x04,0x02,0x00,0x00,
  0x00,0x00,0xE0,0x10,0x08,0x04,0x02,0x00,
  // 0x00,0xC0,0x20,0x10,0x08,0x04,0x00,0x00,0x00,0x00,0xC0,0x20,0x10,0x08,0x04,0x00,//sad1
};

//refuse1
byte refuse1[][8] = {
  0x08,0x04,0x02,0x01,0x02,0x04,0x08,0x00,
  0x00,0x08,0x04,0x02,0x01,0x02,0x04,0x08,
};
byte refuse2[][8] = {
  0x10,0x20,0x40,0x80,0x40,0x20,0x10,0x00,
  0x00,0x10,0x20,0x40,0x80,0x40,0x20,0x10,
};

//amazed
byte amazed1[][8] = {
0x00,0x03,0x04,0x04,0x04,0x04,0x03,0x00,
0x00,0x03,0x04,0x05,0x05,0x04,0x03,0x00,
};
byte amazed2[][8] = {
0x00,0xC0,0x20,0x20,0x20,0x20,0xC0,0x00,
0x00,0xC0,0x20,0xA0,0xA0,0x20,0xC0,0x00,
};

//Grin
byte Grin1[][8] = {
0x00,0x3F,0x40,0x40,0x20,0x10,0x08,0x07,
0x00,0x3F,0x40,0x5F,0x2F,0x17,0x08,0x07,
};
byte Grin2[][8] = {
0x00,0xFC,0x02,0x02,0x04,0x08,0x10,0xE0,
0x00,0xFC,0x02,0xFA,0xF4,0xE8,0x10,0xE0,
};

//Moving mouth
byte movingmouth1[][8] = {
  0x00,0x00,0x00,0x00,0x00,0x00,0x00,0x00,
};
byte movingmouth2[][8] = {
  0x00,0x00,0xF,0x09,0x09,0xF,0x00,0x00,
};

//The brightness values can be set from 1 to 15, with 1 darkest and 15 brightest
#define A 15

byte movingmouth3[8][8] = {
  { 0, 0, 0, 0, 0, 0, 0, 0 },
  { 0, 0, 0, 0, 0, 0, 0, 0 },
  { 0, 0, A, A, A, A, 0, 0 },
  { 0, 0, A, 0, 0, A, 0, 0 },
  { 0, 0, A, 0, 0, A, 0, 0 },
  { 0, 0, A, A, A, A, 0, 0 },
  { 0, 0, 0, 0, 0, 0, 0, 0 },
  { 0, 0, 0, 0, 0, 0, 0, 0 },
};

Freenove_VK16K33 matrix = Freenove_VK16K33();

int emotion_time_next = 0;
int emotion_time_now = 0;
int emotion_count = 0;

//smile
void smile(int delay_ms) {
  int count = sizeof(smile1) / sizeof(smile1[0]);
  emotion_time_next = millis();
  if (emotion_time_next - emotion_time_now >= delay_ms) {
    emotion_time_now = emotion_time_next;
    matrix.showStaticArray(smile1[emotion_count], smile2[emotion_count]);
    emotion_count++;
    if (emotion_count >= count)
      emotion_count = 0;
  }
}

//naughty
void naughty(int delay_ms) {
  int count = sizeof(naughty1) / sizeof(naughty1[0]);
  emotion_time_next = millis();
  if (emotion_time_next - emotion_time_now >= delay_ms) {
    emotion_time_now = emotion_time_next;
    matrix.showStaticArray(naughty1[emotion_count], naughty2[emotion_count]);
    emotion_count++;
    if (emotion_count >= count)
      emotion_count = 0;
  }
}

//wrath
void wrath(int delay_ms) {
  int count = sizeof(wrath1) / sizeof(wrath1[0]);
  emotion_time_next = millis();
  if (emotion_time_next - emotion_time_now >= delay_ms) {
    emotion_time_now = emotion_time_next;
    matrix.showStaticArray(wrath1[emotion_count], wrath2[emotion_count]);
    emotion_count++;
    if (emotion_count >= count)
      emotion_count = 0;
  }
}

//sad
void sad(int delay_ms) {
  int count = sizeof(sad1) / sizeof(sad1[0]);
  emotion_time_next = millis();
  if (emotion_time_next - emotion_time_now >= delay_ms) {
    emotion_time_now = emotion_time_next;
    matrix.showStaticArray(sad1[emotion_count], sad2[emotion_count]);
    emotion_count++;
    if (emotion_count >= count)
      emotion_count = 0;
  }
}

//refuse
void refuse(int delay_ms) {
  int count = sizeof(refuse1) / sizeof(refuse1[0]);
  emotion_time_next = millis();
  if (emotion_time_next - emotion_time_now >= delay_ms) {
    emotion_time_now = emotion_time_next;
    matrix.showStaticArray(refuse1[emotion_count], refuse2[emotion_count]);
    emotion_count++;
    if (emotion_count >= count)
      emotion_count = 0;
  }
}

//amazed
void amazed(int delay_ms) {
  int count = sizeof(amazed1) / sizeof(amazed1[0]);
  emotion_time_next = millis();
  if (emotion_time_next - emotion_time_now >= delay_ms) {
    emotion_time_now = emotion_time_next;
    matrix.showStaticArray(amazed1[emotion_count], amazed2[emotion_count]);
    emotion_count++;
    if (emotion_count >= count)
      emotion_count = 0;
  }
}

//Grin
void Grin(int delay_ms) {  
  int count = sizeof(Grin1) / sizeof(Grin1[0]);
  emotion_time_next = millis();
  if (emotion_time_next - emotion_time_now >= delay_ms) {
    emotion_time_now = emotion_time_next;
    matrix.showStaticArray(Grin1[emotion_count], Grin2[emotion_count]);
    emotion_count++;
    if (emotion_count >= count)
      emotion_count = 0;
  }
}

int moving_expression = -8;
//Moving mouth
void movingMouth(int delay_ms) {
  int count = sizeof(movingmouth1) / sizeof(movingmouth1[0]);
  emotion_time_next = millis();
  if (emotion_time_next - emotion_time_now >= delay_ms) {

    emotion_time_now = emotion_time_next;
    matrix.showLedMatrix(movingmouth3, moving_expression, 0);
    moving_expression++;
    if (moving_expression >= 9)
      moving_expression = -8;
    emotion_count++;
    if (emotion_count >= count)
      emotion_count = 0;
  }
}

//rotate eyes
void eyesRotate(int delay_ms) {
  int count = sizeof(eyeRotate1) / sizeof(eyeRotate1[0]);
  emotion_time_next = millis();
  if (emotion_time_next - emotion_time_now >= delay_ms) {
    emotion_time_now = emotion_time_next;
    matrix.showStaticArray(eyeRotate1[emotion_count], eyeRotate2[emotion_count]);
    emotion_count++;
    if (emotion_count >= count)
      emotion_count = 0;
  }
}

//Blink eyes
void eyesBlink(int delay_ms) {
  emotion_time_next = millis();
  if (emotion_time_next - emotion_time_now >= delay_ms) {
    emotion_time_now = emotion_time_next;
    emotion_count++;
    if (emotion_count <= 10)
      matrix.showStaticArray(eyeBlink[0], eyeBlink[0]);
    else if (emotion_count > 10) {
      int count = sizeof(eyeBlink) / sizeof(eyeBlink[0]);
      matrix.showStaticArray(eyeBlink[(emotion_count - 11)], eyeBlink[(emotion_count - 11)]);
      if ((emotion_count - 10) >= count)
        emotion_count = 0;
    }
  }
}

//smile
void eyesSmile(int delay_ms) {
  int count = sizeof(eyeSmile) / sizeof(eyeSmile[0]);
  emotion_time_next = millis();
  if (emotion_time_next - emotion_time_now >= delay_ms) {
    emotion_time_now = emotion_time_next;
    matrix.showStaticArray(eyeSmile[emotion_count], eyeSmile[emotion_count]);
    emotion_count++;
    if (emotion_count >= count)
      emotion_count = 0;
  }
}

//cry
void eyesCry(int delay_ms) {
  int count = sizeof(eyeCry1) / sizeof(eyeCry1[0]);
  emotion_time_next = millis();
  if (emotion_time_next - emotion_time_now >= delay_ms) {
    emotion_time_now = emotion_time_next;
    matrix.showStaticArray(eyeCry1[emotion_count], eyeCry2[emotion_count]);
    emotion_count++;
    if (emotion_count >= count)
      emotion_count = 0;
  }
}

//wheel
void wheel(int mode, int delay_ms) {
  if (mode == 1) {
    int count = sizeof(wheel_left) / sizeof(wheel_left[0]);
    emotion_time_next = millis();
    if (emotion_time_next - emotion_time_now >= delay_ms) {
      emotion_time_now = emotion_time_next;
      matrix.showStaticArray(wheel_left[emotion_count], wheel_left[emotion_count]);
      emotion_count++;
      if (emotion_count >= count)
        emotion_count = 0;
    }
  }
  if (mode == 2) {
    int count = sizeof(wheel_right) / sizeof(wheel_right[0]);
    emotion_time_next = millis();
    if (emotion_time_next - emotion_time_now >= delay_ms) {
      emotion_time_now = emotion_time_next;
      matrix.showStaticArray(wheel_right[emotion_count], wheel_right[emotion_count]);
      emotion_count++;
      if (emotion_count >= count)
        emotion_count = 0;
    }
  }
}

//show static emotion
void staticEmtions(int emotion) {
  int count = sizeof(static_emotion_left) / sizeof(static_emotion_left[0]);
  emotion = constrain(emotion, 0, count - 1);
  matrix.showStaticArray(static_emotion_left[emotion], static_emotion_right[emotion]);
}

//clear all
void clearEmtions(void) {
  emotion_count = 0;
  int count = sizeof(clearEmotion) / sizeof(clearEmotion[0]);
  for (int i = 0; i < count; i++) {
    matrix.showStaticArray(clearEmotion[i], clearEmotion[i]);
  }
}

//initialize HT16K33
void Emotion_Setup() {
  matrix.init(EMOTION_ADDRESS);
  //Flip the module 180° for display.
  matrix.flipVertical();    //Flips the vertical orientation of the matrices.
  matrix.flipHorizontal();  //Flips the horizontal orientation of the matrices.
  matrix.setBrightness(10);
  emotion_time_now = millis();
}

int emotion_task_mode = 0;
//Emotion show
void Emotion_Show(int mode) {
  if (mode == 0)
    clearEmtions();
  else if (mode == 1)
    // eyesRotate(150);
    smile(200);
  else if (mode == 2)
    // eyesBlink(100);
    naughty(200);
  else if (mode == 3)
    // eyesSmile(200);
    wrath(200);
  else if (mode == 4)
    // eyesCry(200);
    sad(200);
  else if (mode == 5)
    // wheel(2, 100);
    // refuse(100);
    amazed(200);
  else if (mode == 6)
    // wheel(1, 100);
    // movingMouth(100);
    Grin(200);
}

//Emotion set mode
void Emotion_SetMode(int mode) {
  if (mode <= 6)
    emotion_task_mode = mode;
  else if (mode >= 7) {
    // emotion_flag=0;
    emotion_task_mode = 7;
    int emotion_flag = millis() % 22;
    Serial.println("emotion_flag:" + String(emotion_flag));
    staticEmtions(emotion_flag);
  }
}
